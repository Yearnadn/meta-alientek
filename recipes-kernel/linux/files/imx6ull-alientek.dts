// SPDX-License-Identifier: (GPL-2.0 OR MIT)
//
// Copyright (C) 2016 Freescale Semiconductor, Inc.

/dts-v1/;

#include "imx6ull.dtsi"
#include "imx6ull-alientek.dtsi"

/ {
	model = "Freescale i.MX6ULL ALIENTEK Board";
	compatible = "alientek,imx6ull", "fsl,imx6ull";

	leds {
		compatible = "gpio-leds";
		led-heartbeat {
			label = "heartbeat";
			gpios = <&gpio1 3 GPIO_ACTIVE_LOW>;
			linux,default-trigger = "heartbeat";
			default-state = "on";
		};
	};
};

&clks {
	assigned-clocks = <&clks IMX6UL_CLK_PLL3_PFD2>;
	assigned-clock-rates = <320000000>;
};

